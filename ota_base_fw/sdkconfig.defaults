## ota_base_fw/sdkconfig.defaults
```kconfig
# ESP32-C3 Workshop Firmware Configuration

# Flash size - board has 4MB
CONFIG_ESPTOOLPY_FLASHSIZE_4MB=y

# Partition table for OTA
CONFIG_PARTITION_TABLE_CUSTOM=y
CONFIG_PARTITION_TABLE_CUSTOM_FILENAME="partitions.csv"

# WiFi Configuration
CONFIG_ESP_WIFI_STATIC_RX_BUFFER_NUM=10
CONFIG_ESP_WIFI_DYNAMIC_RX_BUFFER_NUM=32
CONFIG_ESP_WIFI_DYNAMIC_TX_BUFFER_NUM=32
CONFIG_ESP_WIFI_AMPDU_TX_ENABLED=y
CONFIG_ESP_WIFI_AMPDU_RX_ENABLED=y

# HTTP Server
CONFIG_HTTPD_MAX_REQ_HDR_LEN=1024
CONFIG_HTTPD_MAX_URI_LEN=512

# mDNS
CONFIG_MDNS_MAX_SERVICES=10

# Logging
CONFIG_LOG_DEFAULT_LEVEL_INFO=y
CONFIG_LOG_MAXIMUM_LEVEL_INFO=y

# FreeRTOS
CONFIG_FREERTOS_HZ=1000

# ESP32-C3 Specific
CONFIG_ESP32C3_REV_MIN_3=y
CONFIG_ESP_CONSOLE_USB_SERIAL_JTAG=y

# OTA
CONFIG_BOOTLOADER_APP_ROLLBACK_ENABLE=y
```
